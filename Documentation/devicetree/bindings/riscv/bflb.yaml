## Documentation/devicetree/bindings/riscv/bflb.yaml
```yaml
# SPDX-License-Identifier: (GPL-2.0-only OR BSD-2-Clause)
%YAML 1.2
---
$id: http://devicetree.org/schemas/riscv/bflb.yaml#
$schema: http://devicetree.org/meta-schemas/core.yaml#

title: Bouffalo Lab RISC-V boards

maintainers:
  - Kwanghoon Son <asdfkwang@gmail.com>

properties:
  $nodename:
    const: '/'
  compatible:
    items:
      - const: sipeed,m1s-dock
      - const: sipeed,m1s
      - const: bflb,bl808

additionalProperties: true
```

## Documentation/devicetree/bindings/serial/bflb,uart.yaml
```yaml
# SPDX-License-Identifier: (GPL-2.0-only OR BSD-2-Clause)
%YAML 1.2
---
$id: http://devicetree.org/schemas/serial/bflb,uart.yaml#
$schema: http://devicetree.org/meta-schemas/core.yaml#

title: Bouffalo Lab UART Controller

description: |
  UART IP used by Bouffalo Lab SoCs. Initial Linux support covers the
  BL808 controller with a 32-byte FIFO. The compatible follows Zephyr.

maintainers:
  - Kwanghoon Son <asdfkwang@gmail.com>

allOf:
  - $ref: serial.yaml#

properties:
  compatible:
    const: bflb,uart

  reg:
    maxItems: 1

  interrupts:
    maxItems: 1

  clocks:
    items:
      - description: Baud rate generator clock

  clock-names:
    items:
      - const: baud

required:
  - compatible
  - reg
  - interrupts
  - clocks
  - clock-names

unevaluatedProperties: false

examples:
  - |
    #include <dt-bindings/interrupt-controller/irq.h>

    uart3: serial@30002000 {
        compatible = "bflb,uart";
        reg = <0x30002000 0x1000>;
        interrupts = <20 IRQ_TYPE_LEVEL_HIGH>;
        clocks = <&uart_baud>;
        clock-names = "baud";
    };
...
```

## fs/rustezfs/Kconfig
```kconfig
# SPDX-License-Identifier: GPL-2.0

config RUSTLFS
	tristate "RustLFS filesystem support"
	depends on RUST
	help
	  This is a log-structured filesystem written in Rust.

	  To compile this as a module, choose M here: the module
	  will be called rustlfs.

	  If unsure, say N.
```
