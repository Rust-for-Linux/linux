// SPDX-License-Identifier: (GPL-2.0+ OR MIT)

#include "bl808.dtsi"

/ {
	compatible = "sipeed,m1s", "bflb,bl808";
	memory@50000000 {
		device_type = "memory";
		reg = <0x50000000 0x04000000>;
	};

	cpus {
		timebase-frequency = <842105>;
	};
};

&xtal {
	clock-frequency = <40000000>;
};
