// SPDX-License-Identifier: (GPL-2.0+ OR MIT)

/dts-v1/;

#include "bl808-sipeed-m1s.dtsi"

/ {
	model = "Sipeed M1s Dock";
	compatible = "sipeed,m1s-dock", "sipeed,m1s", "bflb,bl808";

	chosen {
		stdout-path = "/soc/serial@30002000:115200n8";
	};
};

&uart3 {
	status = "okay";
};
